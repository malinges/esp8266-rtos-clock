## main/Kconfig.projbuild
```kconfig
menu "Application config"

    config SNTP_SERVER
        string "SNTP server"
        default "pool.ntp.org"

    config TZ_NAME
        string "Timezone"
        default "America/Montreal"

    config CLOCK_CLK_PIN
        int "Clock CLK pin number"
        default 5

    config CLOCK_DIO_PIN
        int "Clock DIO pin number"
        default 4

endmenu
```

## sdkconfig.defaults
```kconfig
CONFIG_ESPTOOLPY_BAUD_115200B=n
CONFIG_ESPTOOLPY_BAUD_230401B=n
CONFIG_ESPTOOLPY_BAUD_921600B=y
CONFIG_ESPTOOLPY_BAUD_2MB=n
CONFIG_ESPTOOLPY_BAUD_OTHER=n

CONFIG_ESPTOOLPY_FLASHSIZE_1MB=n
CONFIG_ESPTOOLPY_FLASHSIZE_2MB=n
CONFIG_ESPTOOLPY_FLASHSIZE_4MB=y
CONFIG_ESPTOOLPY_FLASHSIZE_8MB=n
CONFIG_ESPTOOLPY_FLASHSIZE_16MB=n

CONFIG_ESP_PANIC_PRINT_HALT=y
CONFIG_ESP_PANIC_PRINT_REBOOT=n
CONFIG_ESP_PANIC_SILENT_REBOOT=n
CONFIG_ESP_PANIC_GDBSTUB=n

CONFIG_LWIP_IPV6=y
```
